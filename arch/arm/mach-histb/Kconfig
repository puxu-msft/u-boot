## arch/arm/mach-histb/Kconfig
```kconfig
if ARCH_HISTB

choice
	prompt "Select a HiSTB SoC"

config ARCH_HI3798MV2X
	bool "Hi3798M V2XX series SoC"
	select ARM64
	help
	  Support for Hi3798MV2XX series SoCs.

endchoice

if ARCH_HI3798MV2X

choice
	prompt "Select a Hi3798M V2XX based board"

config TARGET_HC2910_2AGHD05
	bool "Skyworth HC2910 with board label 2AGHD05"
	help
	  Support for Skyworth HC2910 with board label 2AGHD05. This board features:
	  - Hisilicon Hi3798MV200 SoC (4xCortex-A53, Mali MP-450)
	  - 2GiB DRAM
	  - 8GiB eMMC, uSD slot
	  - Wifi and Bluetooth module
	  - 1x USB 2.0, 1x USB 3.0 host port
	  - HDMI
	  - SCI
	  - 3 LED - power, Wifi, Lock(?)
	  - 1x Fast Ethernet Controller, 1x GBe Ethernet Controller

config TARGET_CM201_2
	bool "China Mobile CM201-2 (Hi3798MV300)"
	help
	  支持 CM201-2 机顶盒。本板配置：
	  - Hisilicon Hi3798MV300 SoC（4xCortex-A53）
	  - 1GiB DRAM
	  - 8GiB eMMC
	  - 1 个 Fast Ethernet Controller，接内置 FE PHY
	  U-Boot 作为 TF-A BL31 的 BL33 运行，PSCI 由 BL31 提供。

endchoice

endif

source "board/skyworth/hc2910-2aghd05/Kconfig"
source "board/cmcc/cm201-2/Kconfig"

endif
```

## arch/mips/mach-en75xx/Kconfig
```kconfig
menu "EcoNet/Airoha EN75xx platforms"
	depends on ARCH_EN75XX

config SYS_VENDOR
	default "econet"

# Common SoC-identity flag selected by every EN7528 board (reference/RAM/...).
config SOC_EN7528
	bool
	select MIPS_SKIP_CP0_COUNT_CLEAR

config SYS_SOC
	default "en7528" if SOC_EN7528
	default "en7512"

config SYS_BOARD
	default "en7528" if SOC_EN7528
	default "en7512"

config SYS_CONFIG_NAME
	default "en7528" if SOC_EN7528
	default "en7512"

config SYS_MALLOC_F_LEN
	default 0x2000

config SYS_DCACHE_SIZE
	default 32768

config SYS_DCACHE_LINE_SIZE
	default 32

config SYS_ICACHE_SIZE
	default 32768

config SYS_ICACHE_LINE_SIZE
	default 32

config TEXT_BASE
	default 0x80020000 if BOARD_EN7528_RAM
	default 0x81000000

config SPL_TEXT_BASE
	default 0x80010000

config SPL_SIZE_LIMIT
	default 0x30000

config TPL_TEXT_BASE
	default 0xbfc00000

config TPL_MAX_SIZE
	default 0x8000


config BUILD_TARGET
	default "u-boot.img" if BOARD_EN7512_REFERENCE
	default "u-boot.bin" if BOARD_EN7528_REFERENCE
	default "u-boot.bin" if BOARD_EN7528_RAM

choice
	prompt "EN75xx reference board"
	default BOARD_EN7512_REFERENCE

config BOARD_EN7512_REFERENCE
	bool "EN7512/EN7521 reference board"
	select BINMAN
	select SPL_LOADER_SUPPORT if SPL
	help
	  Build a boot image compatible with the EN7512/EN7521 TCBoot flow.
	  TPL initializes the serial flash controller, executes the legacy DDR
	  calibration stage from FE SRAM and loads SPL into DDR.

config BOARD_EN7528_REFERENCE
	bool "EN7528 reference board (DASAN H660GM-A)"
	select SOC_EN7528
	select BINMAN
	select SPL_LOADER_SUPPORT if SPL
	help
	  Build a boot image for the little-endian MIPS1004Kc EN7528. TPL brings
	  up the SoC and runs the FE-SRAM DDR3 calibration stage (en7528_ddr.bin,
	  extracted from the vendor bootloader) before loading SPL into DDR. The exact
	  DDR-stage entry/handoff is validated over UART during bring-up; see
	  doc/board/econet/en7528.rst.

config BOARD_EN7528_RAM
	bool "EN7528 RAM-boot (loaded by the stock bootbase at 0x80020000)"
	select SOC_EN7528
	help
	  Build a standalone U-Boot proper (no TPL/SPL, no DDR blob) linked at
	  0x80020000 to be RAM-loaded by the stock bootbase, which has already
	  initialized DRAM. XMODEM it in from the bldr> prompt ("xmdm 80020000
	  <len>") and run it with "jump 80020000". This is the non-destructive
	  bring-up path that exercises the whole upper stack (console, DTS, DM,
	  U-Boot proper) on real EN7528 silicon without needing the DDR stage.


endchoice

endmenu
```

## board/cmcc/cm201-2/Kconfig
```kconfig
if TARGET_CM201_2

config SYS_BOARD
	default "cm201-2"

config SYS_VENDOR
	default "cmcc"

config SYS_SOC
	default "hi3798mv200"

endif
```

## configs/cm201-2_defconfig
```kconfig
CONFIG_ARM=y
CONFIG_POSITION_INDEPENDENT=y
CONFIG_ARCH_HISTB=y
CONFIG_TEXT_BASE=0x00000000
CONFIG_SYS_MALLOC_LEN=0x2000000
CONFIG_SYS_MALLOC_F_LEN=0x4000
CONFIG_NR_DRAM_BANKS=1
CONFIG_DEFAULT_DEVICE_TREE="hi3798mv300-cm201-2"
CONFIG_TARGET_CM201_2=y
CONFIG_SYS_LOAD_ADDR=0x10000000
CONFIG_IDENT_STRING=" CM201-2"
CONFIG_SYS_BOOTM_LEN=0x4000000
CONFIG_FIT=y
CONFIG_FIT_VERBOSE=y
CONFIG_BOOTDELAY=2
CONFIG_USE_BOOTCOMMAND=y
CONFIG_BOOTCOMMAND="run cm201_boot"
CONFIG_USE_PREBOOT=y
CONFIG_PREBOOT="run cm201_probe"
CONFIG_BOOT_RETRY=y
CONFIG_BOOT_RETRY_TIME=120
CONFIG_RESET_TO_RETRY=y
# CONFIG_EFI_LOADER is not set
# CONFIG_BOOTSTD is not set
# CONFIG_DISPLAY_CPUINFO is not set
CONFIG_SYS_PROMPT="CM201-2# "
CONFIG_SYS_CBSIZE=1024
CONFIG_HUSH_PARSER=y
CONFIG_SYS_MAXARGS=64
CONFIG_CONSOLE_MUX=y
# CONFIG_CMD_SAVEENV is not set
CONFIG_CMD_MMC=y
CONFIG_CMD_USB=y
CONFIG_CMD_PING=y
CONFIG_CMD_FS_GENERIC=y
CONFIG_EFI_PARTITION=y
CONFIG_ENV_IS_NOWHERE=y
CONFIG_NET=y
CONFIG_ARP_TIMEOUT=200
CONFIG_NETCONSOLE=y
CONFIG_HIFEMAC_ETH=y
CONFIG_HIFEMAC_MDIO=y
CONFIG_PHY_ANEG_TIMEOUT=1000
CONFIG_RESET_HISILICON=y
CONFIG_MMC_DW=y
CONFIG_MMC_DW_K3=y
# CONFIG_MMC_WRITE is not set
# CONFIG_MMC_HW_PARTITIONING is not set
CONFIG_SHA256=y
# CONFIG_GPIO is not set
# CONFIG_I2C is not set
# CONFIG_INPUT is not set
# CONFIG_POWER is not set
CONFIG_USB=y
CONFIG_USB_EHCI_HCD=y
CONFIG_USB_EHCI_GENERIC=y
CONFIG_USB_STORAGE=y
# CONFIG_WATCHDOG is not set
# CONFIG_WDT is not set
CONFIG_FS_EXT4=y
CONFIG_FS_FAT=y
```

## configs/en7528_ram_defconfig
```kconfig
CONFIG_MIPS=y
CONFIG_SKIP_LOWLEVEL_INIT=y
CONFIG_SYS_MALLOC_LEN=0x100000
CONFIG_SYS_MALLOC_F_LEN=0x10000
CONFIG_NR_DRAM_BANKS=1
CONFIG_ENV_SIZE=0x1000
CONFIG_DEFAULT_DEVICE_TREE="econet,en7528-ram"
CONFIG_SYS_LOAD_ADDR=0x81800000
CONFIG_ARCH_EN75XX=y
CONFIG_BOARD_EN7528_RAM=y
CONFIG_SYS_MIPS_TIMER_FREQ=200000000
CONFIG_SYS_LITTLE_ENDIAN=y
CONFIG_BOOTDELAY=3
CONFIG_DISPLAY_CPUINFO=y
# CONFIG_DISPLAY_BOARDINFO is not set
CONFIG_BOARD_LATE_INIT=y
CONFIG_HUSH_PARSER=y
CONFIG_SYS_PROMPT="EN7528> "
CONFIG_SYS_MAXARGS=16
CONFIG_CMD_MEMINFO=y
CONFIG_CMD_DM=y
CONFIG_CMD_MTD=y
# CONFIG_CMD_SETEXPR is not set
CONFIG_CMD_DHCP=y
CONFIG_CMD_MII=y
CONFIG_CMD_PING=y
CONFIG_CMD_FAT=y
CONFIG_CMD_FS_GENERIC=y
CONFIG_EFI_PARTITION=y
CONFIG_NET_RANDOM_ETHADDR=y
CONFIG_CLK=y
CONFIG_DMA=y
CONFIG_MTD=y
CONFIG_DM_MTD=y
CONFIG_MTD_SPI_NAND=y
CONFIG_DM_MDIO=y
CONFIG_AIROHA_ETH=y
CONFIG_PHY=y
CONFIG_SPI=y
CONFIG_DM_SPI=y
CONFIG_AIROHA_SNFI_SPI=y
CONFIG_LZMA=y
```

## configs/en7528_reference_defconfig
```kconfig
CONFIG_MIPS=y
CONFIG_SKIP_LOWLEVEL_INIT=y
CONFIG_SYS_MALLOC_LEN=0x100000
CONFIG_SPL_LIBCOMMON_SUPPORT=y
CONFIG_SPL_LIBGENERIC_SUPPORT=y
CONFIG_NR_DRAM_BANKS=1
CONFIG_ENV_SIZE=0x1000
CONFIG_DEFAULT_DEVICE_TREE="econet,en7528-reference"
CONFIG_SPL_SYS_MALLOC_F_LEN=0x10000
CONFIG_SPL_SERIAL=y
CONFIG_TPL_SYS_MALLOC_F_LEN=0x1000
CONFIG_SPL_BSS_START_ADDR=0x80080000
CONFIG_SPL_BSS_MAX_SIZE=0x10000
CONFIG_SYS_LOAD_ADDR=0x81800000
CONFIG_SPL=y
CONFIG_ARCH_EN75XX=y
CONFIG_BOARD_EN7528_REFERENCE=y
CONFIG_SYS_MIPS_TIMER_FREQ=150000000
CONFIG_MIPS_CACHE_SETUP=y
CONFIG_MIPS_CACHE_DISABLE=y
CONFIG_RESTORE_EXCEPTION_VECTOR_BASE=y
CONFIG_MIPS_BOOT_FDT=y
CONFIG_SYS_LITTLE_ENDIAN=y
CONFIG_FIT=y
CONFIG_BOOTDELAY=3
CONFIG_DISPLAY_CPUINFO=y
# CONFIG_DISPLAY_BOARDINFO is not set
CONFIG_SPL_MAX_SIZE=0x30000
CONFIG_SPL_SYS_MALLOC_SIMPLE=y
CONFIG_TPL=y
# CONFIG_TPL_FRAMEWORK is not set
CONFIG_HUSH_PARSER=y
CONFIG_SYS_PROMPT="EN7528> "
CONFIG_SYS_MAXARGS=8
CONFIG_CMD_MEMINFO=y
# CONFIG_CMD_SETEXPR is not set
CONFIG_SPL_OF_CONTROL=y
CONFIG_SPL_DM=y
```

## configs/gs2107_chainload_defconfig
```kconfig
CONFIG_MIPS=y
CONFIG_SKIP_LOWLEVEL_INIT=y
CONFIG_SYS_MALLOC_LEN=0x400000
CONFIG_SYS_MALLOC_F_LEN=0x10000
CONFIG_NR_DRAM_BANKS=1
CONFIG_ENV_SIZE=0x20000
CONFIG_DEFAULT_DEVICE_TREE="econet,gs2107"
CONFIG_SYS_LOAD_ADDR=0x82000000
CONFIG_ARCH_EN75XX=y
CONFIG_BOARD_GS2107=y
CONFIG_TEXT_BASE=0x81000000
CONFIG_SYS_MIPS_TIMER_FREQ=200000000
CONFIG_SYS_LITTLE_ENDIAN=y
CONFIG_SYS_BOOTM_LEN=0x2000000
CONFIG_BOOTDELAY=3
CONFIG_BOOT_RETRY=y
CONFIG_BOOT_RETRY_TIME=5
CONFIG_BOOT_RETRY_MIN=1
CONFIG_RETRY_BOOTCMD=y
CONFIG_DISPLAY_CPUINFO=y
# CONFIG_DISPLAY_BOARDINFO is not set
CONFIG_BOARD_LATE_INIT=y
CONFIG_HUSH_PARSER=y
CONFIG_SYS_PROMPT="GS2107> "
CONFIG_SYS_MAXARGS=16
CONFIG_CMD_MEMINFO=y
CONFIG_CMD_MEMORY=y
CONFIG_CMD_DM=y
CONFIG_CMD_MTD=y
CONFIG_CMD_BOOTM=y
CONFIG_CMD_FDT=y
CONFIG_CMD_ECHO=y
CONFIG_CMD_SOURCE=y
CONFIG_CMD_SAVEENV=y
CONFIG_CMD_HASH=y
CONFIG_SHA256=y
CONFIG_CMD_CRC32=y
CONFIG_CMD_DHCP=y
CONFIG_CMD_MII=y
CONFIG_CMD_PING=y
CONFIG_CMD_TFTPBOOT=y
CONFIG_CMD_FAT=y
CONFIG_CMD_EXT4=y
CONFIG_CMD_FS_GENERIC=y
CONFIG_CMD_USB=y
CONFIG_EFI_PARTITION=y
CONFIG_DOS_PARTITION=y
CONFIG_PARTITIONS=y
CONFIG_BLK=y
CONFIG_ARP_TIMEOUT=1000
CONFIG_NET_RETRY_COUNT=16
CONFIG_NET_RANDOM_ETHADDR=y
CONFIG_NETCONSOLE=y
CONFIG_CONSOLE_MUX=y
# CONFIG_SYS_CONSOLE_IS_IN_ENV is not set
CONFIG_CLK=y
CONFIG_DMA=y
CONFIG_MTD=y
CONFIG_DM_MTD=y
CONFIG_MTD_SPI_NAND=y
CONFIG_MTD_EN75_BMT=y
CONFIG_DM_MDIO=y
CONFIG_AIROHA_ETH=y
CONFIG_PHY=y
CONFIG_NOP_PHY=y
CONFIG_SPI=y
CONFIG_DM_SPI=y
CONFIG_AIROHA_SNFI_SPI=y
CONFIG_LZMA=y
CONFIG_USB=y
CONFIG_DM_USB=y
CONFIG_USB_XHCI_HCD=y
CONFIG_USB_XHCI_MTK=y
CONFIG_USB_STORAGE=y
CONFIG_FS_FAT=y
CONFIG_FS_EXT4=y
CONFIG_FIT=y
CONFIG_MIPS_BOOT_FDT=y
CONFIG_ENV_IS_IN_MTD=y
CONFIG_ENV_MTD_DEV="uboot_env"
CONFIG_ENV_OFFSET=0x0
CONFIG_ENV_OFFSET_REDUND=0x20000
CONFIG_ENV_REDUNDANT=y
CONFIG_ENV_USE_DEFAULT_ENV_TEXT_FILE=y
CONFIG_ENV_DEFAULT_ENV_TEXT_FILE="defenvs/gs2107_env"
CONFIG_ENV_WRITEABLE_LIST=y
CONFIG_ENV_FLAGS_LIST_STATIC="recovery:dw"
CONFIG_BOOTCOUNT_LIMIT=y
CONFIG_BOOTCOUNT_GENERIC=y
CONFIG_SYS_BOOTCOUNT_LE=y
CONFIG_SYS_BOOTCOUNT_ADDR=0xb8100000
CONFIG_CMD_BOOTCOUNT=y
# CONFIG_ENV_IS_NOWHERE is not set
# CONFIG_TOOLS_LIBCRYPTO is not set
# CONFIG_TOOLS_KWBIMAGE is not set
```

## drivers/mtd/nand/spi/Kconfig
```kconfig
menuconfig MTD_SPI_NAND
	bool "SPI NAND device Support"
	depends on DM_MTD && DM_SPI
	select DEVRES
	select MTD_NAND_CORE
	select SPI_MEM
	help
	  This is the framework for the SPI NAND device drivers.

config MTD_EN75_BMT
	bool "EcoNet EN75xx vendor BMT/BBT translation (read-only)"
	depends on MTD_SPI_NAND
	help
	  Honour the EcoNet/Airoha factory BBT and BMT so logical NAND
	  addresses match the bootbase and Linux. Read-only: never rewrite
	  the tables.
```

## drivers/optimus/Kconfig
```kconfig
config OPTIMUS
	bool "Amlogic USB burning (Optimus) protocol core"
	depends on CMDLINE && BLK && PARTITIONS
	select CMD_AML_STORE
	help
	  Amlogic USB 线刷（WorldCup/Optimus）协议的设备侧核心，与传输无关：identify、TPL 命令与状态、bulk 命令、媒体读写（download/upload mem、download store）与命令词分发（其余命令词经 run_command 执行，过红线门）。USB 收发由 USB_FUNCTION_OPTIMUS 提供；核心本身可在 sandbox 里由测试直接喂控制请求与 bulk 数据。
```

## drivers/sm/Kconfig
```kconfig
config SM
	bool

config MESON_SM
	bool "Amlogic Secure Monitor driver"
	depends on ARCH_MESON
	select SM
	help
	  Say y here to enable the Amlogic secure monitor driver.

config SANDBOX_SM
	bool "Sandbox Secure Monitor driver"
	depends on SANDBOX
	select SM
	help
	  Say y here to enable the Sandbox driver for the secure monitor
	  uclass.

config SANDBOX_MESON_SM
	bool "Sandbox model of the Amlogic vendor BL31 secure storage"
	depends on SANDBOX
	select SM
	select AES
	select SHA256
	help
	  按 Amlogic 厂商 BL31（M12 上的 TF-A v1.3:079690f10）反汇编出的语义模拟它的安全存储调用（取共享缓冲、NOTIFY_EX 装载：块头魔数与 SHA-256、AES-256-CBC、内层头声明的块大小、逐对象 SHA-256；READ/TELL/STATUS/LIST/VERSION），eFuse 派生的密钥换成固定测试值；写、删等模型之外的调用返回 SMC_UNK 并计数。供 MESON_UNIFYKEY 与 unifykey 命令在 sandbox 里测试。

config MESON_UNIFYKEY
	bool "Amlogic unifykey (secure storage) client over the vendor BL31"
	depends on MESON_SM || SANDBOX_MESON_SM
	depends on BLK
	select SHA256
	help
	  经 Amlogic 厂商 BL31 的安全存储读 unifykey（mac、deviceid、authkey 等出厂写入的 key）：从块设备分区读出加密块的两份副本，按厂商 u-boot 的规则（info 校验和、magic、stamp）选一份交给 BL31 装载，再按名字读。只读块设备，不写回（不做厂商的副本修复）；只发取缓冲、装载与只读查询的调用。BL31 没有这些调用（如上游 TF-A）时报告不支持。

config MESON_UNIFYKEY_OFFSET
	hex "Offset of the first key block copy in the partition"
	depends on MESON_UNIFYKEY
	default 0x4000
	help
	  第一份副本在分区（厂商 reserved）里的字节偏移；第二份紧随其后，两块 512 B 的 info 再随其后。默认值是厂商虚拟分区表里的 key 区（AML_TABLE 之后）。

config MESON_UNIFYKEY_SIZE
	hex "Size of one key block copy"
	depends on MESON_UNIFYKEY
	range 0x400 0x40000
	default 0x40000
	help
	  一份副本（即交给 BL31 的块）的大小，也是 NOTIFY_EX 的参数；必须与块的内层头声明的大小相同，否则 BL31 清表。上限是 BL31 块缓冲的大小。
```
